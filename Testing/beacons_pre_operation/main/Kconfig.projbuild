## Testing/beacons_pre_operation/main/Kconfig.projbuild
```kconfig
menu "Beacon Custom Config"

    config SCAN_LIST_SIZE
        int "Max size of scan list"
        range 0 20
        default 10
        help
            The size of array that will be used to retrieve the list of access points.

    config WIFI_SSID
        string "SSID"
        default "myssid"
        help
            The SSID of the access point to connect to.
    config WIFI_PASSWORD
        string "Password"
        default "mypassword"
        help
            The password of the access point to connect to.
    config WIFI_SCAN_INTERVAL
        int "The interval between two scans"
        range 0 20
        default 10
        help
            The interval between two scans in seconds.
    config BROKER_URL
        string "Broker URL"
        default "mqtt://192.168.43.19:1883"
        help
            URL of the broker to connect to
    config BEACON_NAME
        string "Beacon name"
        default "mybeacon"
        help
            Name of the beacon
endmenu
```

## Testing/main/Kconfig.projbuild
```kconfig
menu "WIFI Configuration"

    config SCAN_LIST_SIZE
        int "Max size of scan list"
        range 0 20
        default 10
        help
            The size of array that will be used to retrieve the list of access points.

    config WIFI_SSID
        string "SSID"
        default "myssid"
        help
            The SSID of the access point to connect to.
    config WIFI_PASSWORD
        string "Password"
        default "mypassword"
        help
            The password of the access point to connect to.
    config WIFI_SCAN_INTERVAL
        int "The interval between two scans"
        range 0 20
        default 10
        help
            The interval between two scans in seconds.
endmenu
```

## esp32-idf-components/beacons/main/Kconfig.projbuild
```kconfig
menu "Beacon Config"
    config SCAN_LIST_SIZE
        int "Max size of scan list"
        range 0 20
        default 10
        help
            The size of array that will be used to retrieve the list of access points.
    config WIFI_SSID
        string "SSID"
        default "myssid"
        help
            The SSID of the access point to connect to.
    config WIFI_PASSWORD
        string "Password"
        default "mypassword"
        help
            The password of the access point to connect to.
    config WIFI_SCAN_INTERVAL
        int "The interval between two scans"
        range 0 20
        default 10
        help
            The interval between two scans in seconds.
    config BROKER_URL
        string "Broker URL"
        default "mqtt://192.168.43.19:1883"
        help
            URL of the broker to connect to
    config BEACON_NAME
        string "Beacon name"
        default "mybeacon"
        help
            Name of the beacon
endmenu

menu "Station Config"
    config NUM_STATIONS
        int "Number of stations"
        range 0 4
        default 3
        help
            Number of stations to be tracked
    config STATION1_X
        int "x-coordinate of station 1"
        default 0
    config STATION1_Y
        int "y-coordinate of station 1"
        default 0
    config STATION2_X
        int "x-coordinate of station 2"
        default 0
    config STATION2_Y
        int "y-coordinate of station 2"
        default 0
    config STATION3_X
        int "x-coordinate of station 3"
        default 0
    config STATION3_Y
        int "y-coordinate of station 3"
        default 0    
    config STATION4_X
        int "x-coordinate of station 4"
        default 0
    config STATION4_Y
        int "y-coordinate of station 4"
        default 0
endmenu
```
